## lib/Kconfig
```kconfig
menu "Local libraries"

source "$BSP_DIR/lib/wiznet/Kconfig"
source "$BSP_DIR/lib/jsoncpp/Kconfig"
source "$BSP_DIR/lib/zlib/Kconfig"

endmenu
```

## lib/jsoncpp/Kconfig
```kconfig
menuconfig LIB_USING_JSONCPP
    bool "jsoncpp: A C++ library for interacting with JSON. "
    default n
    select RT_USING_CPLUSPLUS
    select RT_USING_LIBC if RT_VER_NUM < 0x40100
```

## lib/tinyxml2/Kconfig
```kconfig
menuconfig LIB_USING_TINYXML2
    bool "TinyXML2: TinyXML2 is a simple, small, efficient, C++ XML parser that can be easily integrated into other programs.  "
    default n
    select RT_USING_CPLUSPLUS
    select RT_USING_LIBC if RT_VER_NUM < 0x40100
```

## lib/wiznet/Kconfig
```kconfig
menuconfig LIB_USING_WIZNET
    bool "WIZnet: WIZnet TCP/IP chips SAL framework implement"
    default n
    select RT_USING_PIN
    select RT_USING_SPI
    select RT_USING_LIBC if RT_VER_NUM < 0x40100
    select RT_USING_SAL
    select RT_USING_TIMER_SOFT
    depends on !PKG_USING_WIZNET

if LIB_USING_WIZNET

    choice
        prompt "WIZnet device type"
        default LIB_WIZNET_USING_W5500
        help
            Select the wiznet type

        config LIB_WIZNET_USING_W5500
            bool "W5500"

    endchoice

    config LIB_WIZNET_DEVICE_EXTERN_CONFIG
         bool
         default n

    if !LIB_WIZNET_DEVICE_EXTERN_CONFIG
        menu "WIZnet device configure"

            config LIB_WIZNET_SPI_DEVICE
                string "SPI device name"
                default "wiz"
        endmenu
    endif

    config LIB_WIZNET_USING_DHCP
        bool "Enable alloc IP address through DHCP"
        default y

    if !LIB_WIZNET_USING_DHCP

        menu "WIZnet network configure"

            config LIB_WIZNET_IPADDR
                string "IPv4: IP address"
                default 192.168.1.10

            config LIB_WIZNET_GWADDR
                string "IPv4: Gateway address"
                default 192.168.1.1

            config LIB_WIZNET_MSKADDR
                string "IPv4: Mask address"
                default 255.255.255.0

        endmenu

    endif

    config LIB_WIZNET_USING_PING
        bool "Enable Ping utility"
        default y

    config LIB_WIZNET_DEBUG
        bool "Enable debug log output"
        default n


endif
```

## lib/zlib/Kconfig
```kconfig
menuconfig LIB_USING_ZLIB
    bool "zlib: A Massively Spiffy Yet Delicately Unobtrusive Compression Library "
    default n
    select RT_USING_LIBC if RT_VER_NUM < 0x40100
    select RT_USING_DFS
    select DFS_USING_POSIX
    depends on !PKG_USING_ZLIB
```
